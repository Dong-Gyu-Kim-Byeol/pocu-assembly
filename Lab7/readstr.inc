; read_string PROC NEAR
;     push bp
;     mov bp, sp
; 
;     mov bx, [bp+4]
;     mov BYTE PTR [bx+1], 5
;     mov BYTE PTR [bx+2], 'z'
;     mov BYTE PTR [bx+3], 'a'
;     mov BYTE PTR [bx+4], 'A'
;     mov BYTE PTR [bx+5], 'D'
;     mov BYTE PTR [bx+6], 'k'
; 
;     pop bp
;     ret
; read_string ENDP

; read_string PROC NEAR ; 0 글자
;     push bp
;     mov bp, sp
; 
;     mov bx, [bp+4]
;     mov BYTE PTR [bx+1], 0
; 
;     pop bp
;     ret
; read_string ENDP

; read_string PROC NEAR ; 1 글자
;     push bp
;     mov bp, sp
; 
;     mov bx, [bp+4]
;     mov BYTE PTR [bx+1], 1
;     mov BYTE PTR [bx+2], 'z'
;     
;     pop bp
;     ret
; read_string ENDP


read_string PROC NEAR ; 254 글자
    push bp
    mov bp, sp

    mov bx, [bp+4]
    mov BYTE PTR [bx+1], 254
    mov BYTE PTR[bx + 2], 'w'
    mov BYTE PTR[bx + 3], 'E'
    mov BYTE PTR[bx + 4], 'n'
    mov BYTE PTR[bx + 5], 'n'
    mov BYTE PTR[bx + 6], 'x'
    mov BYTE PTR[bx + 7], 'p'
    mov BYTE PTR[bx + 8], 'x'
    mov BYTE PTR[bx + 9], 'K'
    mov BYTE PTR[bx + 10], 'w'
    mov BYTE PTR[bx + 11], 'L'
    mov BYTE PTR[bx + 12], 'b'
    mov BYTE PTR[bx + 13], 'L'
    mov BYTE PTR[bx + 14], 'I'
    mov BYTE PTR[bx + 15], 'f'
    mov BYTE PTR[bx + 16], 'B'
    mov BYTE PTR[bx + 17], 'R'
    mov BYTE PTR[bx + 18], 'H'
    mov BYTE PTR[bx + 19], 'F'
    mov BYTE PTR[bx + 20], 'c'
    mov BYTE PTR[bx + 21], 'f'
    mov BYTE PTR[bx + 22], 'O'
    mov BYTE PTR[bx + 23], 'U'
    mov BYTE PTR[bx + 24], 'D'
    mov BYTE PTR[bx + 25], 'f'
    mov BYTE PTR[bx + 26], 'w'
    mov BYTE PTR[bx + 27], 'N'
    mov BYTE PTR[bx + 28], 'o'
    mov BYTE PTR[bx + 29], 'a'
    mov BYTE PTR[bx + 30], 't'
    mov BYTE PTR[bx + 31], 'q'
    mov BYTE PTR[bx + 32], 'f'
    mov BYTE PTR[bx + 33], 'T'
    mov BYTE PTR[bx + 34], 't'
    mov BYTE PTR[bx + 35], 'P'
    mov BYTE PTR[bx + 36], 'x'
    mov BYTE PTR[bx + 37], 'I'
    mov BYTE PTR[bx + 38], 'M'
    mov BYTE PTR[bx + 39], 'C'
    mov BYTE PTR[bx + 40], 'H'
    mov BYTE PTR[bx + 41], 'R'
    mov BYTE PTR[bx + 42], 'L'
    mov BYTE PTR[bx + 43], 'S'
    mov BYTE PTR[bx + 44], 'm'
    mov BYTE PTR[bx + 45], 'O'
    mov BYTE PTR[bx + 46], 'M'
    mov BYTE PTR[bx + 47], 'I'
    mov BYTE PTR[bx + 48], 'n'
    mov BYTE PTR[bx + 49], 'B'
    mov BYTE PTR[bx + 50], 'b'
    mov BYTE PTR[bx + 51], 'b'
    mov BYTE PTR[bx + 52], 'R'
    mov BYTE PTR[bx + 53], 'Q'
    mov BYTE PTR[bx + 54], 'w'
    mov BYTE PTR[bx + 55], 'x'
    mov BYTE PTR[bx + 56], 'V'
    mov BYTE PTR[bx + 57], 'q'
    mov BYTE PTR[bx + 58], 'O'
    mov BYTE PTR[bx + 59], 'F'
    mov BYTE PTR[bx + 60], 'g'
    mov BYTE PTR[bx + 61], 'g'
    mov BYTE PTR[bx + 62], 'z'
    mov BYTE PTR[bx + 63], 'r'
    mov BYTE PTR[bx + 64], 'K'
    mov BYTE PTR[bx + 65], 'G'
    mov BYTE PTR[bx + 66], 'v'
    mov BYTE PTR[bx + 67], 'j'
    mov BYTE PTR[bx + 68], 'n'
    mov BYTE PTR[bx + 69], 'V'
    mov BYTE PTR[bx + 70], 'U'
    mov BYTE PTR[bx + 71], 'c'
    mov BYTE PTR[bx + 72], 'Z'
    mov BYTE PTR[bx + 73], 'r'
    mov BYTE PTR[bx + 74], 'D'
    mov BYTE PTR[bx + 75], 'Z'
    mov BYTE PTR[bx + 76], 't'
    mov BYTE PTR[bx + 77], 'i'
    mov BYTE PTR[bx + 78], 'f'
    mov BYTE PTR[bx + 79], 'J'
    mov BYTE PTR[bx + 80], 'l'
    mov BYTE PTR[bx + 81], 'Q'
    mov BYTE PTR[bx + 82], 'P'
    mov BYTE PTR[bx + 83], 'D'
    mov BYTE PTR[bx + 84], 'z'
    mov BYTE PTR[bx + 85], 'J'
    mov BYTE PTR[bx + 86], 'm'
    mov BYTE PTR[bx + 87], 's'
    mov BYTE PTR[bx + 88], 'Q'
    mov BYTE PTR[bx + 89], 'D'
    mov BYTE PTR[bx + 90], 'B'
    mov BYTE PTR[bx + 91], 'W'
    mov BYTE PTR[bx + 92], 'D'
    mov BYTE PTR[bx + 93], 'N'
    mov BYTE PTR[bx + 94], 'a'
    mov BYTE PTR[bx + 95], 'L'
    mov BYTE PTR[bx + 96], 'R'
    mov BYTE PTR[bx + 97], 'e'
    mov BYTE PTR[bx + 98], 'i'
    mov BYTE PTR[bx + 99], 'U'
    mov BYTE PTR[bx + 100], 'H'
    mov BYTE PTR[bx + 101], 'J'
    mov BYTE PTR[bx + 102], 'h'
    mov BYTE PTR[bx + 103], 'U'
    mov BYTE PTR[bx + 104], 'R'
    mov BYTE PTR[bx + 105], 't'
    mov BYTE PTR[bx + 106], 'v'
    mov BYTE PTR[bx + 107], 'x'
    mov BYTE PTR[bx + 108], 'J'
    mov BYTE PTR[bx + 109], 'O'
    mov BYTE PTR[bx + 110], 'b'
    mov BYTE PTR[bx + 111], 'b'
    mov BYTE PTR[bx + 112], 'k'
    mov BYTE PTR[bx + 113], 'F'
    mov BYTE PTR[bx + 114], 'm'
    mov BYTE PTR[bx + 115], 'Q'
    mov BYTE PTR[bx + 116], 'r'
    mov BYTE PTR[bx + 117], 'K'
    mov BYTE PTR[bx + 118], 'G'
    mov BYTE PTR[bx + 119], 'f'
    mov BYTE PTR[bx + 120], 'G'
    mov BYTE PTR[bx + 121], 'q'
    mov BYTE PTR[bx + 122], 'O'
    mov BYTE PTR[bx + 123], 'g'
    mov BYTE PTR[bx + 124], 'g'
    mov BYTE PTR[bx + 125], 'G'
    mov BYTE PTR[bx + 126], 'p'
    mov BYTE PTR[bx + 127], 'h'
    mov BYTE PTR[bx + 128], 'U'
    mov BYTE PTR[bx + 129], 'f'
    mov BYTE PTR[bx + 130], 'V'
    mov BYTE PTR[bx + 131], 'B'
    mov BYTE PTR[bx + 132], 'I'
    mov BYTE PTR[bx + 133], 'L'
    mov BYTE PTR[bx + 134], 'e'
    mov BYTE PTR[bx + 135], 'T'
    mov BYTE PTR[bx + 136], 'w'
    mov BYTE PTR[bx + 137], 'k'
    mov BYTE PTR[bx + 138], 'M'
    mov BYTE PTR[bx + 139], 'o'
    mov BYTE PTR[bx + 140], 'f'
    mov BYTE PTR[bx + 141], 'X'
    mov BYTE PTR[bx + 142], 'n'
    mov BYTE PTR[bx + 143], 'I'
    mov BYTE PTR[bx + 144], 'F'
    mov BYTE PTR[bx + 145], 'G'
    mov BYTE PTR[bx + 146], 'n'
    mov BYTE PTR[bx + 147], 'V'
    mov BYTE PTR[bx + 148], 'E'
    mov BYTE PTR[bx + 149], 'S'
    mov BYTE PTR[bx + 150], 'H'
    mov BYTE PTR[bx + 151], 'M'
    mov BYTE PTR[bx + 152], 'g'
    mov BYTE PTR[bx + 153], 'p'
    mov BYTE PTR[bx + 154], 'a'
    mov BYTE PTR[bx + 155], 'F'
    mov BYTE PTR[bx + 156], 'l'
    mov BYTE PTR[bx + 157], 'T'
    mov BYTE PTR[bx + 158], 'e'
    mov BYTE PTR[bx + 159], 'r'
    mov BYTE PTR[bx + 160], 'Z'
    mov BYTE PTR[bx + 161], 'x'
    mov BYTE PTR[bx + 162], 'p'
    mov BYTE PTR[bx + 163], 'P'
    mov BYTE PTR[bx + 164], 'D'
    mov BYTE PTR[bx + 165], 'g'
    mov BYTE PTR[bx + 166], 'T'
    mov BYTE PTR[bx + 167], 'D'
    mov BYTE PTR[bx + 168], 'h'
    mov BYTE PTR[bx + 169], 'O'
    mov BYTE PTR[bx + 170], 'y'
    mov BYTE PTR[bx + 171], 'V'
    mov BYTE PTR[bx + 172], 'e'
    mov BYTE PTR[bx + 173], 'i'
    mov BYTE PTR[bx + 174], 'R'
    mov BYTE PTR[bx + 175], 'w'
    mov BYTE PTR[bx + 176], 'h'
    mov BYTE PTR[bx + 177], 'v'
    mov BYTE PTR[bx + 178], 'I'
    mov BYTE PTR[bx + 179], 'h'
    mov BYTE PTR[bx + 180], 'U'
    mov BYTE PTR[bx + 181], 'i'
    mov BYTE PTR[bx + 182], 'A'
    mov BYTE PTR[bx + 183], 'P'
    mov BYTE PTR[bx + 184], 'i'
    mov BYTE PTR[bx + 185], 'J'
    mov BYTE PTR[bx + 186], 'M'
    mov BYTE PTR[bx + 187], 'A'
    mov BYTE PTR[bx + 188], 'B'
    mov BYTE PTR[bx + 189], 'x'
    mov BYTE PTR[bx + 190], 'X'
    mov BYTE PTR[bx + 191], 'A'
    mov BYTE PTR[bx + 192], 'X'
    mov BYTE PTR[bx + 193], 'p'
    mov BYTE PTR[bx + 194], 'R'
    mov BYTE PTR[bx + 195], 'H'
    mov BYTE PTR[bx + 196], 'W'
    mov BYTE PTR[bx + 197], 'O'
    mov BYTE PTR[bx + 198], 'k'
    mov BYTE PTR[bx + 199], 'M'
    mov BYTE PTR[bx + 200], 'B'
    mov BYTE PTR[bx + 201], 'T'
    mov BYTE PTR[bx + 202], 'a'
    mov BYTE PTR[bx + 203], 'i'
    mov BYTE PTR[bx + 204], 'A'
    mov BYTE PTR[bx + 205], 'g'
    mov BYTE PTR[bx + 206], 'o'
    mov BYTE PTR[bx + 207], 'v'
    mov BYTE PTR[bx + 208], 'e'
    mov BYTE PTR[bx + 209], 'p'
    mov BYTE PTR[bx + 210], 'h'
    mov BYTE PTR[bx + 211], 'F'
    mov BYTE PTR[bx + 212], 'y'
    mov BYTE PTR[bx + 213], 'y'
    mov BYTE PTR[bx + 214], 'X'
    mov BYTE PTR[bx + 215], 'G'
    mov BYTE PTR[bx + 216], 'E'
    mov BYTE PTR[bx + 217], 's'
    mov BYTE PTR[bx + 218], 'g'
    mov BYTE PTR[bx + 219], 'G'
    mov BYTE PTR[bx + 220], 'i'
    mov BYTE PTR[bx + 221], 'N'
    mov BYTE PTR[bx + 222], 'N'
    mov BYTE PTR[bx + 223], 'z'
    mov BYTE PTR[bx + 224], 'l'
    mov BYTE PTR[bx + 225], 'I'
    mov BYTE PTR[bx + 226], 'F'
    mov BYTE PTR[bx + 227], 'h'
    mov BYTE PTR[bx + 228], 'Q'
    mov BYTE PTR[bx + 229], 'N'
    mov BYTE PTR[bx + 230], 'B'
    mov BYTE PTR[bx + 231], 'F'
    mov BYTE PTR[bx + 232], 'F'
    mov BYTE PTR[bx + 233], 'Y'
    mov BYTE PTR[bx + 234], 'H'
    mov BYTE PTR[bx + 235], 'E'
    mov BYTE PTR[bx + 236], 'n'
    mov BYTE PTR[bx + 237], 'p'
    mov BYTE PTR[bx + 238], 'S'
    mov BYTE PTR[bx + 239], 'p'
    mov BYTE PTR[bx + 240], 'r'
    mov BYTE PTR[bx + 241], 'i'
    mov BYTE PTR[bx + 242], 'A'
    mov BYTE PTR[bx + 243], 'V'
    mov BYTE PTR[bx + 244], 't'
    mov BYTE PTR[bx + 245], 'W'
    mov BYTE PTR[bx + 246], 'w'
    mov BYTE PTR[bx + 247], 'J'
    mov BYTE PTR[bx + 248], 'Y'
    mov BYTE PTR[bx + 249], 't'
    mov BYTE PTR[bx + 250], 'h'
    mov BYTE PTR[bx + 251], 'a'
    mov BYTE PTR[bx + 252], 'V'
    mov BYTE PTR[bx + 253], 'G'
    mov BYTE PTR[bx + 254], 'I'
    mov BYTE PTR[bx + 255], 'h'

    pop bp
    ret
read_string ENDP